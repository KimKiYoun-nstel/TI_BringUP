// SPDX-License-Identifier: GPL-2.0-only OR MIT
/*
 * USB-root rehearsal DT variant for Texas Instruments AM642 SK.
 *
 * Exported from the local kernel workspace so the next USB-root
 * experiments have a repo-traceable DTS candidate.
 */

/dts-v1/;

#include "k3-am642-sk.dts"

&usbss0 {
	/* Prefer the simpler USB2-only path over USB3/SerDes dependency. */
	ti,usb2-only;
};

&serdes_wiz0 {
	status = "disabled";
};

&usb0 {
	dr_mode = "host";
	maximum-speed = "high-speed";
	/delete-property/ phys;
	/delete-property/ phy-names;
};
